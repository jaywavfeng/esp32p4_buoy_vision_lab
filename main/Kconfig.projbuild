## main/Kconfig.projbuild
```kconfig
menu "Wi-Fi Camera Web Control"

    config APP_WIFI_SSID
        string "Wi-Fi SSID"
        default "YOUR_WIFI_SSID"

    config APP_WIFI_PASSWORD
        string "Wi-Fi password"
        default "YOUR_WIFI_PASSWORD"

    config APP_AP_SSID
        string "SoftAP SSID"
        default "P4_Buoy_Lab"

    config APP_AP_PASSWORD
        string "SoftAP password"
        default "change-me-please"

    config APP_AP_CHANNEL
        int "SoftAP channel"
        default 6
        range 1 13

    config APP_AP_MAX_CLIENTS
        int "SoftAP max clients"
        default 4
        range 1 8

    config APP_AP_STATIC_IP
        string "SoftAP static IPv4 address"
        default "192.168.4.1"
        help
            Static SoftAP address used for direct phone access.

    config APP_AP_NETMASK
        string "SoftAP IPv4 netmask"
        default "255.255.255.0"

    config APP_AP_GATEWAY
        string "SoftAP IPv4 gateway"
        default "192.168.4.1"

    config APP_DEFAULT_NETWORK_MODE
        int "Default network mode: 0 STA, 1 SoftAP, 2 AP+STA"
        default 2
        range 0 2
        help
            STA connects to the configured router. SoftAP starts the board's own hotspot.
            AP+STA keeps the hotspot alive while also trying to join the router.

    config APP_NETWORK_BOOT_WINDOW_MS
        int "Network boot access window in milliseconds"
        default 300000
        range 10000 3600000
        help
            Wi-Fi and HTTP stay available for at least this long after boot.

    config APP_NETWORK_IDLE_TIMEOUT_MS
        int "Network idle shutdown timeout in milliseconds"
        default 300000
        range 10000 3600000
        help
            After the boot window, Wi-Fi and HTTP stop once AP, HTTP and stream activity
            have all been idle for this long. They reopen on the next reboot.

    config APP_NETWORK_WATCHDOG_PERIOD_MS
        int "Network idle watchdog period in milliseconds"
        default 5000
        range 1000 60000

    config APP_ETH_ENABLE
        bool "Enable Ethernet file-transfer interface"
        default y
        help
            Start the onboard ESP32-P4 Ethernet interface alongside Wi-Fi.
            This is intended for wired recording download and maintenance.

    config APP_ETH_DHCP_TIMEOUT_MS
        int "Ethernet DHCP timeout before static fallback"
        default 8000
        range 1000 60000
        help
            If Ethernet link is up but DHCP does not assign an address within
            this time, the firmware switches the Ethernet netif to the static
            fallback address below. This makes direct board-to-PC cables usable
            when the PC does not provide DHCP.

    config APP_ETH_STATIC_FALLBACK_IP
        string "Ethernet static fallback IPv4 address"
        default "169.254.100.2"

    config APP_ETH_STATIC_FALLBACK_NETMASK
        string "Ethernet static fallback IPv4 netmask"
        default "255.255.0.0"

    config APP_MDNS_ENABLE
        bool "Enable mDNS fixed local hostname"
        default y
        help
            Advertise the HTTP server as http://<hostname>.local/ on active
            network interfaces. IP addresses remain available as fallbacks.

    config APP_HOSTNAME
        string "mDNS hostname"
        default "p4-buoy"

    config APP_USB_MSC_ENABLE
        bool "Enable USB1 high-speed TF mass storage"
        default y
        help
            Expose the TF card as a writable USB mass-storage device on the
            ESP32-P4 high-speed OTG port. The application and USB host never
            own the filesystem at the same time.

    config APP_USB_MSC_AUTO_EXPORT
        bool "Automatically enter USB export after host enumeration"
        depends on APP_USB_MSC_ENABLE
        default y

    config APP_USB_MSC_SD_FREQ_KHZ
        int "USB export SDMMC frequency in kHz"
        depends on APP_USB_MSC_ENABLE
        default 40000
        range 400 40000
        help
            This affects only USB mass-storage mode. Field capture continues
            to use APP_SD_MAX_FREQ_KHZ.

    config APP_USB_MSC_PRODUCT_NAME
        string "USB mass-storage product name"
        depends on APP_USB_MSC_ENABLE
        default "P4 Buoy TF Storage"

    config APP_STORAGE_TIMESHARE_BOOT_PROBE_MS
        int "Automatic boot TF maintenance probe delay in milliseconds"
        default 0
        range 0 600000
        help
            Set to 0 to keep the TF maintenance window manual only. Non-zero values
            stop Wi-Fi/ESP-Hosted after the delay to test the TF card while the SDIO
            transport is down, then reboot to restore AP+STA.

    config APP_DEFAULT_RECOGNITION_METHOD
        int "Default recognition method: 0 off, 1 MLP, 2 YOLO26, 3 YOLO11, 4 COCO YOLO11n 320, 5 TinyCNN, 6 Fish31"
        default 6
        range 0 6
        help
            Fish31 is the default board classifier. TinyCNN is the 6-class
            marine classifier, and COCO is the ESP-DL board-side detection
            comparison route. Historical experiment routes are hidden unless
            APP_ENABLE_LEGACY_COKE_SPRITE is enabled.

    config APP_TINY_CLS_MODEL_FILE
        string "TinyCNN ESP-DL model file"
        default "../models/tiny_cls_xl_deep_192_6cls_s8_p4.espdl"
        help
            Path to the TinyCNN .espdl model embedded into firmware.
            Relative paths are resolved from the main component directory.

    config APP_TINY_CLS_INPUT_SIZE
        int "TinyCNN input size"
        default 192
        range 32 320
        help
            Square TinyCNN input size. Must match the embedded ESP-DL model.

    config APP_FISH31_MODEL_FILE
        string "Fish31 ESP-DL model file"
        default "../models/fish31_mbv3s_075_224_s8_p4.espdl"
        help
            Path to the Fish31 .espdl model embedded into firmware.
            Relative paths are resolved from the main component directory.

    config APP_FISH31_INPUT_SIZE
        int "Fish31 input size"
        default 224
        range 32 320
        help
            Square Fish31 input size. Must match the embedded ESP-DL model.

    config APP_ENABLE_LEGACY_COKE_SPRITE
        bool "Enable legacy experiment model routes"
        default n
        help
            Keep this disabled for the v3.0.0 customer firmware. When disabled,
            legacy experiment assets are not compiled into the firmware and the
            API/UI path exposes only fish31, tinycls, coco, and off. The source
            files are retained for historical reproduction, but the old model
            assets are not shipped in this release.

    config APP_YOLO26_BOARD_ENABLE
        bool "Enable board-side YOLO26 ESP-DL inference"
        depends on APP_ENABLE_LEGACY_COKE_SPRITE
        default n
        help
            Enable the historical YOLO26n experiment model embedded from models/.
            The firmware still depends on the espressif/yolo26 component for the postprocessor,
            but the graph loaded at runtime is models/yolo26_coke_sprite_raw_heads_416_allint8_p4.espdl.

    config APP_WIFI_MAX_RETRY
        int "Maximum retry count before continuing forever"
        default 0
        help
            Set to 0 to keep reconnecting forever.

    config APP_HTTP_PART_BOUNDARY
        string "HTTP MJPEG part boundary"
        default "123456789000000000000987654321"

    config APP_FRAME_BUFFER_BYTES
        int "Latest JPEG/client frame buffer bytes"
        default 262144
        range 65536 1048576
        help
            Maximum bytes reserved for the cached JPEG frame and each stream client's copy buffer.

    config APP_FILE_DOWNLOAD_CHUNK_BYTES
        int "HTTP file download chunk bytes"
        default 65536
        range 8192 262144
        help
            Buffer size used when reading TF files and sending HTTP chunks.

    config APP_STREAM_MAX_FPS
        int "Maximum MJPEG FPS per client"
        default 12
        range 1 30

    config APP_MAX_STREAM_CLIENTS
        int "Maximum concurrent MJPEG stream clients"
        default 4
        range 1 6
        help
            Increase this only if PSRAM and Wi-Fi bandwidth are sufficient.

    config APP_ASYNC_WORKER_TASK_STACK_SIZE
        int "Async stream worker task stack size"
        default 8192
        range 4096 16384

    config APP_CAMERA_TASK_STACK_SIZE
        int "Camera capture task stack size"
        default 8192
        range 4096 16384

    config APP_CAMERA_TASK_PRIORITY
        int "Camera capture task priority"
        default 6
        range 1 20

    config APP_INFERENCE_TASK_STACK_SIZE
        int "YOLO inference worker task stack size"
        default 12288
        range 8192 24576
        help
            Stack for the independent YOLO worker. Keep it separate from the camera task
            so long ESP-DL runs do not stop frame capture and MJPEG streaming.

    config APP_INFERENCE_TASK_PRIORITY
        int "YOLO inference worker task priority"
        default 4
        range 1 20
        help
            Lower than the camera task by default. The worker consumes copied JPEG frames
            from a depth-1 queue and publishes results asynchronously.

    config APP_BOOT_STANDBY
        bool "Start in standby after boot"
        default y

    config APP_SD_ENABLE
        bool "Enable TF card storage"
        default y

    config APP_SD_MOUNT_POINT
        string "TF card mount point"
        default "/sdcard"

    config APP_FLASH_STORAGE_LABEL
        string "Internal flash fallback FAT partition label"
        default "storage"
        help
            Partition label used as the online fallback file store when the TF
            card cannot be mounted. It is mounted at the same VFS path as the
            TF card so history, timeline and validation APIs remain available.

    config APP_SD_USE_SDMMC
        bool "Use SDMMC host for TF card instead of SDSPI"
        default y
        help
            The TF card socket on ESP32-P4 Function EV Board / P4-Eye uses
            SDMMC Slot 0 pins CMD=44, CLK=43, D0-D3=39-42. ESP-Hosted Wi-Fi
            uses a different SDIO slot and pin group, so SDMMC Slot 0 should be
            tried before SDSPI.

    config APP_SD_BUS_WIDTH
        int "TF card SDMMC bus width"
        default 4
        range 1 4

    config APP_SD_MAX_FREQ_KHZ
        int "TF card bus max frequency in kHz"
        default 20000
        range 400 40000
        help
            Maximum TF card bus frequency used by both SDMMC and SDSPI mounts.
            20000 is the IDF default speed; raise only after board-side signal
            integrity has been verified.

    config APP_SD_PIN_CMD
        int "TF card SDMMC CMD pin"
        default 44

    config APP_SD_PIN_CLK
        int "TF card SDMMC CLK pin"
        default 43

    config APP_SD_PIN_D0
        int "TF card SDMMC D0 pin"
        default 39

    config APP_SD_PIN_D1
        int "TF card SDMMC D1 pin"
        default 40

    config APP_SD_PIN_D2
        int "TF card SDMMC D2 pin"
        default 41

    config APP_SD_PIN_D3
        int "TF card SDMMC D3 pin"
        default 42

    config APP_SD_LDO_IO_ID
        int "TF card internal LDO channel"
        default 4
        range 1 4

    config APP_HISTORY_ENABLE
        bool "Enable recognition history"
        default y

    config APP_CAN_BOX_MIN_SCORE
        int "Recognition minimum box score"
        default 96
        range 50 100
        help
            Minimum candidate score, in percent, required before the legacy recognizer draws a box
            and records a positive object result. Increase it to reduce false boxes; decrease it to
            recover more weak detections.

    config APP_INFERENCE_INTERVAL_MS
        int "Recognition inference interval in milliseconds"
        default 0
        range 0 600000
        help
            Minimum interval between two recognizer runs. Use 0 for every frame.
            TinyCNN is intended to run continuously. YOLO inference is much slower
            than MLP on the board. Use about 3000-5000 ms for YOLO11, and 30000 ms
            or more for YOLO26 when the video stream is active.

    config APP_HISTORY_SAMPLE_INTERVAL_MS
        int "Recognition history sample interval in milliseconds"
        default 2000
        range 250 600000

    config APP_HISTORY_MAX_RECORDS
        int "Recognition history records kept in RAM"
        default 128
        range 16 512

    config APP_HISTORY_MAX_SNAPSHOTS
        int "Recognition snapshot files kept on TF card"
        default 1800
        range 32 20000

    config APP_HISTORY_INDEX_MAX_KB
        int "Maximum history JSONL file size before rotation"
        default 2048
        range 128 65536

    config APP_HISTORY_SAVE_JPEG
        bool "Save sampled JPEG snapshots with recognition history"
        default y

    config APP_RECORDING_ENABLE
        bool "Enable TF card MJPEG segment recording"
        default y
        help
            Save boot-session camera video as short MJPEG segment files on TF card.
            Recognition metadata is written to JSONL indexes for monitoring-style review.

    config APP_RECORDING_SEGMENT_MS
        int "Recording segment length in milliseconds"
        default 60000
        range 5000 14400000

    config APP_RECORDING_MAX_FPS
        int "Maximum TF recording FPS"
        default 4
        range 1 15
        help
            The live stream can run faster. This limit protects TF write bandwidth and
            keeps COCO inference responsive while still providing reviewable video.

    config APP_FIELD_RECORDING_MAX_FPS
        int "Maximum raw AVI FPS in field capture mode"
        default 12
        range 1 30
        help
            Field mode shuts down network services and prioritizes raw AVI capture.

    config APP_ENRICHMENT_ENABLE
        bool "Enable idle annotated-video enrichment"
        default y

    config APP_ENRICHMENT_IDLE_MS
        int "Idle time before annotated-video enrichment"
        depends on APP_ENRICHMENT_ENABLE
        default 15000
        range 5000 600000

    config APP_ENRICHMENT_INITIAL_STRIDE
        int "Initial inference stride for annotated video"
        depends on APP_ENRICHMENT_ENABLE
        default 8
        range 1 32

    config APP_ENRICHMENT_TASK_STACK_SIZE
        int "Annotated-video enrichment task stack size"
        depends on APP_ENRICHMENT_ENABLE
        default 16384
        range 8192 32768

    config APP_RECORDING_MAX_SEGMENTS
        int "Maximum AVI recording segments kept on TF card"
        default 20000
        range 4 20000

    config APP_RECORDING_QUEUE_DEPTH
        int "Recording writer queue depth"
        default 16
        range 1 16

    config APP_SUMMARY_INTERVAL_MS
        int "Periodic recognition summary interval"
        default 60000
        range 5000 600000

    config APP_DATASET_RUN_MAX_FRAMES
        int "Maximum TF dataset frames per HTTP validation run"
        default 16
        range 1 64

    config APP_HISTORY_TASK_STACK_SIZE
        int "History storage task stack size"
        default 8192
        range 4096 16384

    config APP_RECORDING_TASK_STACK_SIZE
        int "AVI recording task stack size"
        default 16384
        range 8192 24576

    config APP_HISTORY_TASK_PRIORITY
        int "History storage task priority"
        default 4
        range 1 20

    config EXAMPLE_CAMERA_VIDEO_BUFFER_NUMBER
        int "Camera video buffer number"
        default 2
        range 1 4

    config EXAMPLE_JPEG_COMPRESSION_QUALITY
        int "JPEG compression quality"
        default 75
        range 1 100

endmenu
```
