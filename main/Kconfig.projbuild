## sdkconfig.defaults
```kconfig
CONFIG_APP_WIFI_SSID="YOUR_WIFI_SSID"
CONFIG_APP_WIFI_PASSWORD="YOUR_WIFI_PASSWORD"
CONFIG_APP_AP_SSID="P4_Buoy_Lab"
CONFIG_APP_AP_PASSWORD="change-me-please"
CONFIG_APP_AP_CHANNEL=6
CONFIG_APP_AP_MAX_CLIENTS=4
CONFIG_APP_AP_STATIC_IP="192.168.4.1"
CONFIG_APP_AP_NETMASK="255.255.255.0"
CONFIG_APP_AP_GATEWAY="192.168.4.1"
CONFIG_APP_DEFAULT_NETWORK_MODE=2
CONFIG_APP_NETWORK_BOOT_WINDOW_MS=300000
CONFIG_APP_NETWORK_IDLE_TIMEOUT_MS=300000
CONFIG_APP_NETWORK_WATCHDOG_PERIOD_MS=5000
CONFIG_APP_ETH_ENABLE=y
CONFIG_APP_ETH_DHCP_TIMEOUT_MS=8000
CONFIG_APP_ETH_STATIC_FALLBACK_IP="169.254.100.2"
CONFIG_APP_ETH_STATIC_FALLBACK_NETMASK="255.255.0.0"
CONFIG_APP_MDNS_ENABLE=y
CONFIG_APP_HOSTNAME="p4-buoy"
CONFIG_APP_USB_MSC_ENABLE=y
CONFIG_APP_USB_MSC_AUTO_EXPORT=y
CONFIG_APP_USB_MSC_SD_FREQ_KHZ=20000
CONFIG_APP_USB_MSC_PRODUCT_NAME="P4 Buoy TF Storage"
CONFIG_TINYUSB_MSC_ENABLED=y
CONFIG_TINYUSB_MSC_BUFSIZE=24576
CONFIG_TINYUSB_DESC_PRODUCT_STRING="P4 Buoy TF Storage"
CONFIG_FATFS_USE_LABEL=y
CONFIG_TINYUSB_DESC_MSC_STRING="P4 Buoy TF Storage"
CONFIG_APP_STORAGE_TIMESHARE_BOOT_PROBE_MS=0
CONFIG_APP_DEFAULT_RECOGNITION_METHOD=6
CONFIG_APP_TINY_CLS_MODEL_FILE="../models/tiny_cls_xl_deep_192_6cls_s8_p4.espdl"
CONFIG_APP_TINY_CLS_INPUT_SIZE=192
CONFIG_APP_FISH31_MODEL_FILE="../models/fish31_mbv3s_075_224_s8_p4.espdl"
CONFIG_APP_FISH31_INPUT_SIZE=224
CONFIG_APP_ENABLE_LEGACY_COKE_SPRITE=n
# CONFIG_APP_YOLO26_BOARD_ENABLE is not set
CONFIG_ESP_TASK_WDT_TIMEOUT_S=30
CONFIG_ESP_TASK_WDT_CHECK_IDLE_TASK_CPU1=n
CONFIG_APP_WIFI_MAX_RETRY=0
CONFIG_APP_HTTP_PART_BOUNDARY="123456789000000000000987654321"
CONFIG_APP_FRAME_BUFFER_BYTES=262144
CONFIG_APP_FILE_DOWNLOAD_CHUNK_BYTES=65536
CONFIG_APP_STREAM_MAX_FPS=12
CONFIG_APP_MAX_STREAM_CLIENTS=4
CONFIG_APP_ASYNC_WORKER_TASK_STACK_SIZE=8192
CONFIG_APP_CAMERA_TASK_STACK_SIZE=8192
CONFIG_APP_CAMERA_TASK_PRIORITY=6
CONFIG_APP_INFERENCE_TASK_STACK_SIZE=12288
CONFIG_APP_INFERENCE_TASK_PRIORITY=4
CONFIG_APP_BOOT_STANDBY=y
CONFIG_APP_SD_ENABLE=y
CONFIG_APP_SD_MOUNT_POINT="/sdcard"
CONFIG_APP_FLASH_STORAGE_LABEL="storage"
CONFIG_APP_SD_USE_SDMMC=y
CONFIG_APP_SD_BUS_WIDTH=4
CONFIG_APP_SD_MAX_FREQ_KHZ=20000
CONFIG_APP_SD_PIN_CMD=44
CONFIG_APP_SD_PIN_CLK=43
CONFIG_APP_SD_PIN_D0=39
CONFIG_APP_SD_PIN_D1=40
CONFIG_APP_SD_PIN_D2=41
CONFIG_APP_SD_PIN_D3=42
CONFIG_APP_SD_LDO_IO_ID=4
CONFIG_APP_HISTORY_ENABLE=y
CONFIG_APP_CAN_BOX_MIN_SCORE=96
CONFIG_APP_INFERENCE_INTERVAL_MS=0
CONFIG_APP_HISTORY_SAMPLE_INTERVAL_MS=2000
CONFIG_APP_HISTORY_MAX_RECORDS=128
CONFIG_APP_HISTORY_MAX_SNAPSHOTS=1800
CONFIG_APP_HISTORY_INDEX_MAX_KB=2048
CONFIG_APP_HISTORY_SAVE_JPEG=y
CONFIG_APP_RECORDING_ENABLE=y
CONFIG_APP_RECORDING_SEGMENT_MS=60000
CONFIG_APP_RECORDING_MAX_FPS=4
CONFIG_APP_FIELD_RECORDING_MAX_FPS=12
CONFIG_APP_ENRICHMENT_ENABLE=y
CONFIG_APP_ENRICHMENT_IDLE_MS=15000
CONFIG_APP_ENRICHMENT_INITIAL_STRIDE=8
CONFIG_APP_ENRICHMENT_TASK_STACK_SIZE=16384
CONFIG_APP_RECORDING_MAX_SEGMENTS=20000
CONFIG_APP_RECORDING_QUEUE_DEPTH=16
CONFIG_VFS_MAX_COUNT=16
CONFIG_APP_SUMMARY_INTERVAL_MS=60000
CONFIG_APP_DATASET_RUN_MAX_FRAMES=16
CONFIG_APP_HISTORY_TASK_STACK_SIZE=8192
CONFIG_APP_RECORDING_TASK_STACK_SIZE=16384
CONFIG_APP_HISTORY_TASK_PRIORITY=4

CONFIG_IDF_EXPERIMENTAL_FEATURES=y
CONFIG_SPIRAM=y
CONFIG_SPIRAM_SPEED_200M=y
# CONFIG_FREERTOS_TASK_CREATE_ALLOW_EXT_MEM is not set
CONFIG_ESP_MAIN_TASK_STACK_SIZE=8192
CONFIG_LWIP_MAX_SOCKETS=16
CONFIG_COMPILER_OPTIMIZATION_PERF=y
# CONFIG_COMPILER_OPTIMIZATION_DEBUG is not set
# CONFIG_COMPILER_OPTIMIZATION_SIZE is not set
# CONFIG_COMPILER_OPTIMIZATION_NONE is not set

CONFIG_EXAMPLE_CAMERA_VIDEO_BUFFER_NUMBER=2
CONFIG_EXAMPLE_JPEG_COMPRESSION_QUALITY=75
CONFIG_EXAMPLE_SELECT_ESP32P4_FUNCTION_EV_BOARD_V1_5=y
CONFIG_EXAMPLE_SDMMC_MOUNT_POINT="/sdcard"
# CONFIG_EXAMPLE_SDMMC_BUS_WIDTH_1 is not set
CONFIG_EXAMPLE_SDMMC_BUS_WIDTH_4=y
CONFIG_EXAMPLE_ENABLE_MIPI_CSI_CAM_SENSOR=y
CONFIG_EXAMPLE_SELECT_JPEG_HW_DRIVER=y
# CONFIG_EXAMPLE_SELECT_JPEG_ESP_NEW_JPEG is not set

CONFIG_CAMERA_OV5647=y
CONFIG_CAMERA_OV5647_AUTO_DETECT_MIPI_INTERFACE_SENSOR=y
CONFIG_CAMERA_OV5647_MIPI_RAW8_800X640_50FPS=y
CONFIG_CAMERA_OV5647_MIPI_DEFAULT_FMT_RAW8_800X640_50FPS=y
CONFIG_CAMERA_OV5647_MIPI_RAW10_1920X1080_30FPS=y
CONFIG_CAMERA_OV5647_CSI_LINESYNC_ENABLE=y
CONFIG_CAMERA_OV5647_DEFAULT_IPA_JSON_CONFIGURATION_FILE=y

CONFIG_CAMERA_SC2336=y
CONFIG_CAMERA_SC2336_AUTO_DETECT_MIPI_INTERFACE_SENSOR=y
CONFIG_CAMERA_SC2336_MIPI_RAW8_1280X720_30FPS=y
CONFIG_CAMERA_SC2336_MIPI_DEFAULT_FMT_RAW8_1280X720_30FPS=y
CONFIG_CAMERA_SC2336_DEFAULT_IPA_JSON_CONFIGURATION_FILE=y

CONFIG_ESP_VIDEO_ENABLE_MIPI_CSI_VIDEO_DEVICE=y
CONFIG_ESP_VIDEO_ENABLE_ISP_PIPELINE_CONTROLLER=y
CONFIG_ESP_VIDEO_ENABLE_SWAP_BYTE=y
CONFIG_ESP_VIDEO_ENABLE_SWAP_BYTE_RISCV=y
CONFIG_ESP_WIFI_STA_DISCONNECTED_PM_ENABLE=n
CONFIG_ESP_HOSTED_SDIO_CLOCK_FREQ_KHZ=20000
CONFIG_ESP_HOSTED_SDIO_OPTIMIZATION_RX_MAX_SIZE=y
# CONFIG_ESP_HOSTED_SDIO_OPTIMIZATION_RX_STREAMING_MODE is not set

CONFIG_PARTITION_TABLE_CUSTOM=y
CONFIG_PARTITION_TABLE_CUSTOM_FILENAME="partitions.csv"
CONFIG_PARTITION_TABLE_FILENAME="partitions.csv"

# Fast board-side validation path while the TF card is unavailable.
# Official Espressif COCO YOLO11n 320 INT8 model: about 600 ms model latency on ESP32-P4.
# CONFIG_FLASH_COCO_DETECT_YOLO11N_S8_V1 is not set
# CONFIG_FLASH_COCO_DETECT_YOLO11N_S8_V2 is not set
# CONFIG_FLASH_COCO_DETECT_YOLO11N_S8_V3 is not set
CONFIG_FLASH_COCO_DETECT_YOLO11N_320_S8_V3=y
# CONFIG_COCO_DETECT_YOLO11N_S8_V1 is not set
# CONFIG_COCO_DETECT_YOLO11N_S8_V2 is not set
# CONFIG_COCO_DETECT_YOLO11N_S8_V3 is not set
CONFIG_COCO_DETECT_YOLO11N_320_S8_V3=y
CONFIG_DEFAULT_COCO_DETECT_MODEL=3
CONFIG_COCO_DETECT_MODEL_IN_FLASH_RODATA=y
# CONFIG_COCO_DETECT_MODEL_IN_FLASH_PARTITION is not set
# CONFIG_COCO_DETECT_MODEL_IN_SDCARD is not set
CONFIG_COCO_DETECT_MODEL_LOCATION=0
```

## sdkconfig.defaults.esp32p4
```kconfig
# CONFIG_ESP32P4_SELECTS_REV_LESS_V3 is not set
# CONFIG_ESP32P4_REV_MIN_0 is not set
# CONFIG_ESP32P4_REV_MIN_1 is not set
# CONFIG_ESP32P4_REV_MIN_100 is not set
# CONFIG_ESP32P4_REV_MIN_300 is not set
CONFIG_ESP32P4_REV_MIN_301=y
CONFIG_ESP32P4_REV_MIN_FULL=301
CONFIG_ESP_REV_MIN_FULL=301
CONFIG_ESP32P4_REV_MAX_FULL=399
CONFIG_ESP_REV_MAX_FULL=399
CONFIG_ESP_DEFAULT_CPU_FREQ_MHZ_360=y
# CONFIG_ESP_DEFAULT_CPU_FREQ_MHZ_400 is not set
CONFIG_ESP_DEFAULT_CPU_FREQ_MHZ=360
# CONFIG_CACHE_L2_CACHE_128KB is not set
CONFIG_CACHE_L2_CACHE_256KB=y
# CONFIG_CACHE_L2_CACHE_512KB is not set
CONFIG_CACHE_L2_CACHE_SIZE=0x40000
# CONFIG_CACHE_L2_CACHE_LINE_64B is not set
CONFIG_CACHE_L2_CACHE_LINE_128B=y
CONFIG_CACHE_L2_CACHE_LINE_SIZE=128
CONFIG_CACHE_L1_CACHE_LINE_SIZE=64
# CONFIG_ESPTOOLPY_FLASHSIZE_2MB is not set
CONFIG_ESPTOOLPY_FLASHSIZE_16MB=y
CONFIG_ESPTOOLPY_FLASHSIZE="16MB"

# ESP32-P4 Function EV Board: P4 host + onboard ESP32-C6 Wi-Fi coprocessor.
CONFIG_SLAVE_IDF_TARGET_ESP32C6=y
CONFIG_ESP_HOSTED_P4_DEV_BOARD_FUNC_BOARD=y
# CONFIG_ESP_HOSTED_SPI_HOST_INTERFACE is not set
CONFIG_ESP_HOSTED_SDIO_HOST_INTERFACE=y
# CONFIG_ESP_HOSTED_SPI_HD_HOST_INTERFACE is not set
CONFIG_ESP_HOSTED_SPI_HSPI=y
# CONFIG_ESP_HOSTED_SPI_VSPI is not set
CONFIG_ESP_HOSTED_HS_ACTIVE_HIGH=y
CONFIG_ESP_HOSTED_DR_ACTIVE_HIGH=y
CONFIG_ESP_HOSTED_SPI_RESET_ACTIVE_HIGH=y
CONFIG_ESP_HOSTED_SPI_HSPI_GPIO_MOSI=14
CONFIG_ESP_HOSTED_SPI_HSPI_GPIO_MISO=15
CONFIG_ESP_HOSTED_SPI_HSPI_GPIO_CLK=18
CONFIG_ESP_HOSTED_SPI_HSPI_GPIO_CS=19
CONFIG_ESP_HOSTED_SPI_GPIO_MOSI=14
CONFIG_ESP_HOSTED_SPI_GPIO_MISO=15
CONFIG_ESP_HOSTED_SPI_GPIO_CLK=18
CONFIG_ESP_HOSTED_SPI_GPIO_CS=19
CONFIG_ESP_HOSTED_SPI_GPIO_HANDSHAKE=16
CONFIG_ESP_HOSTED_SPI_GPIO_DATA_READY=17
CONFIG_ESP_HOSTED_SPI_GPIO_RESET_SLAVE=54
CONFIG_ESP_HOSTED_SPI_FREQ_ESP32C6=40
CONFIG_ESP_HOSTED_SPI_CLK_FREQ=40
CONFIG_ESP_HOSTED_SPI_TX_Q_SIZE=20
CONFIG_ESP_HOSTED_SPI_RX_Q_SIZE=20
CONFIG_ESP_HOSTED_GPIO_SLAVE_RESET_SLAVE=54

CONFIG_WIFI_RMT_STATIC_RX_BUFFER_NUM=16
CONFIG_WIFI_RMT_DYNAMIC_RX_BUFFER_NUM=64
CONFIG_WIFI_RMT_DYNAMIC_TX_BUFFER_NUM=64
CONFIG_WIFI_RMT_AMPDU_TX_ENABLED=y
CONFIG_WIFI_RMT_TX_BA_WIN=32
CONFIG_WIFI_RMT_AMPDU_RX_ENABLED=y
CONFIG_WIFI_RMT_RX_BA_WIN=32

CONFIG_LWIP_TCP_SND_BUF_DEFAULT=65534
CONFIG_LWIP_TCP_WND_DEFAULT=65534
CONFIG_LWIP_TCP_RECVMBOX_SIZE=64
CONFIG_LWIP_UDP_RECVMBOX_SIZE=64
CONFIG_LWIP_TCPIP_RECVMBOX_SIZE=64
CONFIG_LWIP_TCP_SACK_OUT=y
```

## sdkconfig.defaults.rev31
```kconfig
# ESP32-P4 rev3.1 production/test profile.
# Common application settings remain in sdkconfig.defaults.
# CONFIG_ESP32P4_SELECTS_REV_LESS_V3 is not set
# CONFIG_ESP32P4_REV_MIN_0 is not set
# CONFIG_ESP32P4_REV_MIN_1 is not set
# CONFIG_ESP32P4_REV_MIN_100 is not set
# CONFIG_ESP32P4_REV_MIN_300 is not set
CONFIG_ESP32P4_REV_MIN_301=y
CONFIG_ESP32P4_REV_MIN_FULL=301
CONFIG_ESP_REV_MIN_FULL=301
CONFIG_ESP32P4_REV_MAX_FULL=399
CONFIG_ESP_REV_MAX_FULL=399
# CONFIG_ESP_DEFAULT_CPU_FREQ_MHZ_360 is not set
CONFIG_ESP_DEFAULT_CPU_FREQ_MHZ_400=y
CONFIG_ESP_DEFAULT_CPU_FREQ_MHZ=400
```
